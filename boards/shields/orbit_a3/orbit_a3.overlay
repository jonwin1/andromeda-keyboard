#include <dt-bindings/zmk/matrix_transform.h>

#include "orbit_a3-layouts.dtsi"
#include "orbit_a3-trackball.dtsi"

/ {
    chosen {
        zmk,physical-layout = &default_layout;
    };

    kscan: kscan {
        compatible = "zmk,kscan-gpio-matrix";
        diode-direction = "col2row";
        wakeup-source;

        col-gpios
            = <&gpio0 22 GPIO_ACTIVE_HIGH>
            , <&gpio0 24 GPIO_ACTIVE_HIGH>
            , <&gpio1 0 GPIO_ACTIVE_HIGH>
            ;

        row-gpios
            = <&gpio0 11 (GPIO_ACTIVE_HIGH | GPIO_PULL_DOWN)>
            ;
    };

    default_transform: default_transform {
        compatible = "zmk,matrix-transform";
        columns = <3>;
        rows = <1>;

        map = <
            RC(0, 0) RC(0, 1) RC(0, 2)
        >;
    };
};
