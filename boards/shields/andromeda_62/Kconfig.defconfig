## boards/shields/andromeda_62/Kconfig.defconfig
```kconfig
if SHIELD_ANDROMEDA_62_LEFT

config ZMK_KEYBOARD_NAME
    default "Andromeda 62"

config ZMK_SPLIT_ROLE_CENTRAL
    default y

endif # SHIELD_ANDROMEDA_62_LEFT

if SHIELD_ANDROMEDA_62_LEFT || SHIELD_ANDROMEDA_62_RIGHT

config ZMK_SPLIT
    default y

endif # SHIELD_ANDROMEDA_62_LEFT || SHIELD_ANDROMEDA_62_RIGHT
```

## boards/shields/andromeda_62/Kconfig.shield
```kconfig
config SHIELD_ANDROMEDA_62_LEFT
    def_bool $(shields_list_contains,andromeda_62_left)

config SHIELD_ANDROMEDA_62_RIGHT
    def_bool $(shields_list_contains,andromeda_62_right)
```

## boards/shields/andromeda_64/Kconfig.defconfig
```kconfig
if SHIELD_ANDROMEDA_64_LEFT

config ZMK_KEYBOARD_NAME
    default "Andromeda 64"

config ZMK_SPLIT_ROLE_CENTRAL
    default y

endif # SHIELD_ANDROMEDA_64_LEFT

if SHIELD_ANDROMEDA_64_LEFT || SHIELD_ANDROMEDA_64_RIGHT

config ZMK_SPLIT
    default y

endif # SHIELD_ANDROMEDA_64_LEFT || SHIELD_ANDROMEDA_64_RIGHT
```

## boards/shields/andromeda_64/Kconfig.shield
```kconfig
config SHIELD_ANDROMEDA_64_LEFT
    def_bool $(shields_list_contains,andromeda_64_left)

config SHIELD_ANDROMEDA_64_RIGHT
    def_bool $(shields_list_contains,andromeda_64_right)
```

## boards/shields/orbit_a3/Kconfig.defconfig
```kconfig
if SHIELD_ORBIT_A3

config ZMK_KEYBOARD_NAME
    default "Orbit A3"

endif # SHIELD_ORBIT_A3
```
